## drivers/gpu/drm/panel/msm8953-generated/Kconfig
```kconfig
menu "MSM8953 panel drivers generated with linux-mdss-dsi-panel-driver-generator"
	depends on GPIOLIB && OF && REGULATOR
	depends on DRM_MIPI_DSI

config DRM_PANEL_MSM8953_GENERATED
	tristate "Select all generated MSM8953 panel drivers by default"

config DRM_PANEL_BOE_BS052FHM_A00_6C01
	tristate "Boe BS052FHM A00 6C01"
	default DRM_PANEL_MSM8953_GENERATED

config DRM_PANEL_CSOT_622_V0
	tristate "Csot 622 V0"
	default DRM_PANEL_MSM8953_GENERATED

config DRM_PANEL_FAIRPHONE_FP3_HX83112B
	tristate "Fairphone FP3 HX83112B"
	default DRM_PANEL_MSM8953_GENERATED

config DRM_PANEL_HIMAX_HX8399C_FHDPLUS
	tristate "Himax HX8399C FHDPLUS"
	default DRM_PANEL_MSM8953_GENERATED

config DRM_PANEL_HUAWEI_MILAN_BOE_OTM1906C
	tristate "Huawei MILAN BOE OTM1906C"
	default DRM_PANEL_MSM8953_GENERATED

config DRM_PANEL_HUAWEI_MILAN_BOE_TD4322
	tristate "Huawei MILAN BOE TD4322"
	default DRM_PANEL_MSM8953_GENERATED

config DRM_PANEL_HUAWEI_MILAN_BOE_TEST1906C
	tristate "Huawei MILAN BOE TEST1906C"
	default DRM_PANEL_MSM8953_GENERATED

config DRM_PANEL_HUAWEI_MILAN_CTC_NT35596S
	tristate "Huawei MILAN CTC NT35596S"
	default DRM_PANEL_MSM8953_GENERATED

config DRM_PANEL_HUAWEI_MILAN_CTC_OTM1906C
	tristate "Huawei MILAN CTC OTM1906C"
	default DRM_PANEL_MSM8953_GENERATED

config DRM_PANEL_HUAWEI_MILAN_JDI_R63452
	tristate "Huawei MILAN JDI R63452"
	default DRM_PANEL_MSM8953_GENERATED

config DRM_PANEL_HUAWEI_MILAN_TIANMA_FIC8736
	tristate "Huawei MILAN TIANMA FIC8736"
	default DRM_PANEL_MSM8953_GENERATED

config DRM_PANEL_HUAWEI_MILAN_TIANMA_FOCAL8716
	tristate "Huawei MILAN TIANMA FOCAL8716"
	default DRM_PANEL_MSM8953_GENERATED

config DRM_PANEL_HUAWEI_MILAN_TIANMA_OTM1906C
	tristate "Huawei MILAN TIANMA OTM1906C"
	default DRM_PANEL_MSM8953_GENERATED

config DRM_PANEL_LENOVO_CD_18781Y_FT8201
	tristate "Lenovo CD 18781Y FT8201"
	default DRM_PANEL_MSM8953_GENERATED

config DRM_PANEL_LENOVO_CD_18781Y_HX83100A
	tristate "Lenovo CD 18781Y HX83100A"
	default DRM_PANEL_MSM8953_GENERATED

config DRM_PANEL_LENOVO_CD_18781Y_JD9365
	tristate "Lenovo CD 18781Y JD9365"
	default DRM_PANEL_MSM8953_GENERATED

config DRM_PANEL_MDSS_FT8716_FHD
	tristate "Mdss FT8716 FHD"
	default DRM_PANEL_MSM8953_GENERATED

config DRM_PANEL_MDSS_ILI7807_FHD
	tristate "Mdss ILI7807 FHD"
	default DRM_PANEL_MSM8953_GENERATED

config DRM_PANEL_MDSS_ILI7807_FHDPLUS
	tristate "Mdss ILI7807 FHDPLUS"
	default DRM_PANEL_MSM8953_GENERATED

config DRM_PANEL_MDSS_NT35596_EBBG
	tristate "Mdss NT35596 EBBG"
	default DRM_PANEL_MSM8953_GENERATED

config DRM_PANEL_MDSS_OTM1911_FHD
	tristate "Mdss OTM1911 FHD"
	default DRM_PANEL_MSM8953_GENERATED

config DRM_PANEL_MDSS_OTM1911_FHDPLUS
	tristate "Mdss OTM1911 FHDPLUS"
	default DRM_PANEL_MSM8953_GENERATED

config DRM_PANEL_MDSS_R63350
	tristate "Mdss R63350"
	default DRM_PANEL_MSM8953_GENERATED

config DRM_PANEL_OFILM_622_V0
	tristate "Ofilm 622 V0"
	default DRM_PANEL_MSM8953_GENERATED

config DRM_PANEL_TENOR_HX8399C_AUO
	tristate "Tenor HX8399C_AUO"
	default DRM_PANEL_MSM8953_GENERATED

config DRM_PANEL_TENOR_ILI7807D_DJN_AUO
	tristate "Tenor ILI7807D_DJN_AUO"
	default DRM_PANEL_MSM8953_GENERATED

config DRM_PANEL_TENOR_ILI7807D_DJN
	tristate "Tenor ILI7807D_DJN"
	default DRM_PANEL_MSM8953_GENERATED

config DRM_PANEL_TIANMA_622_V0
	tristate "Tianma 622 V0"
	default DRM_PANEL_MSM8953_GENERATED

config DRM_PANEL_TIANMA_TL052VDXP02
	tristate "Tianma TL052VDXP02"
	default DRM_PANEL_MSM8953_GENERATED

config DRM_PANEL_TIANMA_TL057FVXP01
	tristate "Tianma TL057FVXP01"
	default DRM_PANEL_MSM8953_GENERATED

config DRM_PANEL_XIAOMI_AUO_R61322
	tristate "Xiaomi AUO R61322"
	default DRM_PANEL_MSM8953_GENERATED

config DRM_PANEL_XIAOMI_BOE_ILI9885
	tristate "Xiaomi BOE ILI9885"
	default DRM_PANEL_MSM8953_GENERATED

config DRM_PANEL_XIAOMI_EBBG_R63350
	tristate "Xiaomi EBBG R63350"
	default DRM_PANEL_MSM8953_GENERATED

config DRM_PANEL_XIAOMI_NT35532
	tristate "Xiaomi NT35532"
	default DRM_PANEL_MSM8953_GENERATED

config DRM_PANEL_XIAOMI_NT36672_CSOT_FHDPLUS_E7
	tristate "Xiaomi NT36672 CSOT FHDPLUS E7"
	default DRM_PANEL_MSM8953_GENERATED

config DRM_PANEL_XIAOMI_NT36672_TIANMA_FHDPLUS_E7
	tristate "Xiaomi NT36672 TIANMA FHDPLUS E7"
	default DRM_PANEL_MSM8953_GENERATED

config DRM_PANEL_XIAOMI_ONCLITE_HX8394F
	tristate "Xiaomi ONCLITE HX8394F"
	default DRM_PANEL_MSM8953_GENERATED

config DRM_PANEL_XIAOMI_ONCLITE_ILI9881
	tristate "Xiaomi ONCLITE ILI9881"
	default DRM_PANEL_MSM8953_GENERATED

config DRM_PANEL_XIAOMI_ONCLITE_OTM1901A
	tristate "Xiaomi ONCLITE OTM1901A"
	default DRM_PANEL_MSM8953_GENERATED

config DRM_PANEL_XIAOMI_OTM1911
	tristate "Xiaomi OTM1911"
	default DRM_PANEL_MSM8953_GENERATED

config DRM_PANEL_XIAOMI_TD4310_EBBG_FHDPLUS_E7
	tristate "Xiaomi TD4310 EBBG FHDPLUS E7"
	default DRM_PANEL_MSM8953_GENERATED

config DRM_PANEL_XIAOMI_TD4310_FHDPLUS_E7_G55
	tristate "Xiaomi TD4310 FHDPLUS E7 G55"
	default DRM_PANEL_MSM8953_GENERATED

config DRM_PANEL_XIAOMI_TD4310_FHDPLUS_E7
	tristate "Xiaomi TD4310 FHDPLUS E7"
	default DRM_PANEL_MSM8953_GENERATED

config DRM_PANEL_XIAOMI_TIANMA_NT35596
	tristate "Xiaomi TIANMA NT35596"
	default DRM_PANEL_MSM8953_GENERATED

config DRM_PANEL_XIAOMI_TIANMA_R63350
	tristate "Xiaomi TIANMA R63350"
	default DRM_PANEL_MSM8953_GENERATED

config DRM_PANEL_XIAOMI_YSL_HX8394F
	tristate "Xiaomi YSL HX8394F"
	default DRM_PANEL_MSM8953_GENERATED

config DRM_PANEL_XIAOMI_YSL_ILI7807D
	tristate "Xiaomi YSL ILI7807D"
	default DRM_PANEL_MSM8953_GENERATED

config DRM_PANEL_XIAOMI_YSL_ILI9881C
	tristate "Xiaomi YSL ILI9881C"
	default DRM_PANEL_MSM8953_GENERATED

endmenu
```
